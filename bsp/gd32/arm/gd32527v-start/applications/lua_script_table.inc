/* Auto-generated by lua2inc.py - DO NOT EDIT */
/* Source files:
 *   led_blink.lua
 */

#ifndef __LUA_SCRIPT_TABLE_INC__
#define __LUA_SCRIPT_TABLE_INC__

#include "lua_script.h"

const lua_script_t lua_script_table[] = {
    {"led_blink", "-- led_blink.lua\n"
"-- GD32F527V-START PB12 LED 闪烁示例\n"
"-- 用法: 在 Lua 交互模式下 dofile(\"scripts/led_blink.lua\")\n"
"-- 或直接粘贴下面内容执行\n"
"\n"
"gpio_mode(28, 1)   -- PB12, output (1=PIN_MODE_OUTPUT)\n"
"\n"
"print(\"LED blinking on PB12...\")\n"
"for i = 1, 10 do\n"
"    gpio_write(28, 1)    -- 亮\n"
"    rtos_delay(200)\n"
"    gpio_write(28, 0)    -- 灭\n"
"    rtos_delay(200)\n"
"end\n"
"print(\"Done!\")"},  /* 392 bytes */
    {NULL, NULL}
};

/* 脚本名称列表 */
static const char *lua_script_names[] = {
    "led_blink",
    NULL
};

#endif /* __LUA_SCRIPT_TABLE_INC__ */
